## config/boards/shields/prospector_adapter/Kconfig.shield
```kconfig
# No whitespace after the comma or in the keyboard name!
config SHIELD_TOTEM_DONGLE
    def_bool $(shields_list_contains,totem_dongle)
```
